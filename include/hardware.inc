; MC6800 ROM monitor hardware definitions

ROM_BASE         equ $E000
ROM_END          equ $FFFF
MONITOR_BASE     equ $E200
MONITOR_REENTRY  equ MONITOR_BASE+$000D

        include "../build/monitor_config.inc"

ACIA_CTRL        equ $8018
ACIA_DATA        equ $8019
ACIA2_CTRL       equ $8094
ACIA2_DATA       equ $8095

; PIAアドレスはエミュレータ暫定値。実機SBC-IOの最終決定は #54 で扱う。
PIA_BASE         equ $8050
PIA_PRA          equ PIA_BASE
PIA_CRA          equ PIA_BASE+1
PIA_PRB          equ PIA_BASE+2
PIA_CRB          equ PIA_BASE+3

PIA_DDR_SELECT   equ $04

SPI_SCLK         equ $01
SPI_MOSI         equ $02
SPI_MISO         equ $04
SPI_CS           equ $08
SPI_OUTPUT_MASK  equ SPI_SCLK+SPI_MOSI+SPI_CS

CHR_CR           equ $0D
CHR_LF           equ $0A
CHR_BS           equ $08
CHR_DEL          equ $7F
CHR_SPACE        equ $20
CHR_PROMPT       equ ']'
CHR_ECHO         equ '='
CHR_QUESTION     equ '?'

LINE_BUF_SIZE    equ 96
LINE_BUF         equ MONITOR_RAM_BASE
LINE_PTR         equ LINE_BUF+LINE_BUF_SIZE
LINE_LEN         equ LINE_PTR+2
HEX_VALUE_HI     equ LINE_LEN+1
HEX_VALUE_LO     equ HEX_VALUE_HI+1
HEX_NIBBLE       equ HEX_VALUE_LO+1
DUMP_ADDR        equ HEX_NIBBLE+1
MOD_ADDR         equ DUMP_ADDR+2
LOADER_MODE      equ MOD_ADDR+2
LOADER_COUNT     equ LOADER_MODE+1
LOADER_SUM       equ LOADER_COUNT+1
LOADER_ADDR      equ LOADER_SUM+1
LOADER_TYPE      equ LOADER_ADDR+2
LOADER_STAGE     equ LOADER_TYPE+1
LOADER_INPUT     equ LOADER_STAGE+1
LOADER_PARSE_PTR equ LOADER_INPUT+1
LOADER_ENTRY     equ LOADER_PARSE_PTR+2
LOADER_ENTRY_SET equ LOADER_ENTRY+2
DUMP_END         equ LOADER_ENTRY_SET+1
DUMP_COUNT       equ DUMP_END+2
ARG_PTR          equ DUMP_COUNT+1
ARG_LEN          equ ARG_PTR+2
ARG2_PTR         equ ARG_LEN+1
ARG2_LEN         equ ARG2_PTR+2
BP_ADDR          equ ARG2_LEN+1
BP_ORIG          equ BP_ADDR+2
BP_ACTIVE        equ BP_ORIG+1
BRK_ACTIVE       equ BP_ACTIVE+1
BRK_FRAME        equ BRK_ACTIVE+1
BRK_ADDR         equ BRK_FRAME+2
BRK_USER_SP      equ BRK_ADDR+2
DISASM_ADDR      equ BRK_USER_SP+2
DISASM_COUNT     equ DISASM_ADDR+2
BRK_SAVE_CC      equ DISASM_COUNT+1
BRK_SAVE_B       equ BRK_SAVE_CC+1
BRK_SAVE_A       equ BRK_SAVE_B+1
BRK_SAVE_X       equ BRK_SAVE_A+1
BRK_SAVE_PC      equ BRK_SAVE_X+2
FILL_VALUE       equ BRK_SAVE_PC+2
 if MONITOR_FEATURE_SD
SD_ERROR         equ FILL_VALUE+1
SD_LBA0          equ SD_ERROR+1
SD_LBA1          equ SD_LBA0+1
SD_LBA2          equ SD_LBA1+1
SD_LBA3          equ SD_LBA2+1
SD_PORTB_SHADOW  equ SD_LBA3+1
SD_TX            equ SD_PORTB_SHADOW+1
SD_RX            equ SD_TX+1
SD_BIT_COUNT     equ SD_RX+1
SD_TIMEOUT_HI    equ SD_BIT_COUNT+1
SD_TIMEOUT_LO    equ SD_TIMEOUT_HI+1
SD_CMD_BYTE      equ SD_TIMEOUT_LO+1
SD_CRC_BYTE      equ SD_CMD_BYTE+1
SD_BUF_PTR       equ SD_CRC_BYTE+1
FAT_ERROR        equ SD_BUF_PTR+2
FAT_VOLUME_LBA0  equ FAT_ERROR+1
FAT_VOLUME_LBA1  equ FAT_VOLUME_LBA0+1
FAT_VOLUME_LBA2  equ FAT_VOLUME_LBA1+1
FAT_VOLUME_LBA3  equ FAT_VOLUME_LBA2+1
FAT_FAT_LBA0     equ FAT_VOLUME_LBA3+1
FAT_FAT_LBA1     equ FAT_FAT_LBA0+1
FAT_FAT_LBA2     equ FAT_FAT_LBA1+1
FAT_FAT_LBA3     equ FAT_FAT_LBA2+1
FAT_DATA_LBA0    equ FAT_FAT_LBA3+1
FAT_DATA_LBA1    equ FAT_DATA_LBA0+1
FAT_DATA_LBA2    equ FAT_DATA_LBA1+1
FAT_DATA_LBA3    equ FAT_DATA_LBA2+1
FAT_ROOT_CLUS0   equ FAT_DATA_LBA3+1
FAT_ROOT_CLUS1   equ FAT_ROOT_CLUS0+1
FAT_ROOT_CLUS2   equ FAT_ROOT_CLUS1+1
FAT_ROOT_CLUS3   equ FAT_ROOT_CLUS2+1
FAT_SEC_PER_CLUS equ FAT_ROOT_CLUS3+1
FAT_RSVD_HI      equ FAT_SEC_PER_CLUS+1
FAT_RSVD_LO      equ FAT_RSVD_HI+1
FAT_NUM_FATS     equ FAT_RSVD_LO+1
FAT_FATSZ0       equ FAT_NUM_FATS+1
FAT_FATSZ1       equ FAT_FATSZ0+1
FAT_FATSZ2       equ FAT_FATSZ1+1
FAT_FATSZ3       equ FAT_FATSZ2+1
FAT_FIND_NAME0   equ FAT_FATSZ3+1
FAT_FIND_NAME1   equ FAT_FIND_NAME0+1
FAT_FIND_NAME2   equ FAT_FIND_NAME1+1
FAT_FIND_NAME3   equ FAT_FIND_NAME2+1
FAT_FIND_NAME4   equ FAT_FIND_NAME3+1
FAT_FIND_NAME5   equ FAT_FIND_NAME4+1
FAT_FIND_NAME6   equ FAT_FIND_NAME5+1
FAT_FIND_NAME7   equ FAT_FIND_NAME6+1
FAT_FIND_NAME8   equ FAT_FIND_NAME7+1
FAT_FIND_NAME9   equ FAT_FIND_NAME8+1
FAT_FIND_NAME10  equ FAT_FIND_NAME9+1
FAT_CUR_CLUS0    equ FAT_FIND_NAME10+1
FAT_CUR_CLUS1    equ FAT_CUR_CLUS0+1
FAT_CUR_CLUS2    equ FAT_CUR_CLUS1+1
FAT_CUR_CLUS3    equ FAT_CUR_CLUS2+1
FAT_NEXT_CLUS0   equ FAT_CUR_CLUS3+1
FAT_NEXT_CLUS1   equ FAT_NEXT_CLUS0+1
FAT_NEXT_CLUS2   equ FAT_NEXT_CLUS1+1
FAT_NEXT_CLUS3   equ FAT_NEXT_CLUS2+1
FAT_FILE_CLUS0   equ FAT_NEXT_CLUS3+1
FAT_FILE_CLUS1   equ FAT_FILE_CLUS0+1
FAT_FILE_CLUS2   equ FAT_FILE_CLUS1+1
FAT_FILE_CLUS3   equ FAT_FILE_CLUS2+1
FAT_FILE_SIZE0   equ FAT_FILE_CLUS3+1
FAT_FILE_SIZE1   equ FAT_FILE_SIZE0+1
FAT_FILE_SIZE2   equ FAT_FILE_SIZE1+1
FAT_FILE_SIZE3   equ FAT_FILE_SIZE2+1
FAT_BYTES_REM0   equ FAT_FILE_SIZE3+1
FAT_BYTES_REM1   equ FAT_BYTES_REM0+1
FAT_BYTES_REM2   equ FAT_BYTES_REM1+1
FAT_BYTES_REM3   equ FAT_BYTES_REM2+1
FAT_ENTRY_PTR    equ FAT_BYTES_REM3+1
FAT_READ_PTR     equ FAT_ENTRY_PTR+2
FAT_COPY_COUNT   equ FAT_READ_PTR+2
FAT_TMP          equ FAT_COPY_COUNT+2
FAT_DIR_COUNT    equ FAT_TMP+1
FAT_SECTOR_IN_CLUS equ FAT_DIR_COUNT+1
 endif
RAMTEST_CMP_SAFE equ $00F0
RAMTEST_END_SAFE equ $00F2
RAMTEST_SP_SAFE  equ $00F4
RAMTEST_STACK_TOP equ $00EF

 if MONITOR_FEATURE_SD
SD_ERR_NONE      equ 0
SD_ERR_TIMEOUT   equ 1
SD_ERR_R1        equ 2
SD_ERR_R7        equ 3
SD_ERR_OCR       equ 4
SD_ERR_TOKEN     equ 5

FAT_ERR_NONE     equ 0
FAT_ERR_SD       equ 1
FAT_ERR_SIG      equ 2
FAT_ERR_MBR      equ 3
FAT_ERR_BPB      equ 4
FAT_ERR_NOT_FOUND equ 5
FAT_ERR_CHAIN    equ 6
FAT_ERR_SIZE     equ 7
 endif

LOAD_MODE_NONE   equ 0
LOAD_MODE_SREC   equ 1
LOAD_MODE_IHEX   equ 2

LOAD_INPUT_ACIA  equ 0
 if MONITOR_FEATURE_SD
LOAD_INPUT_FAT   equ 1
 endif

ACIA_STAT_RDRF   equ $01
ACIA_STAT_TDRE   equ $02

ACIA_CTRL_RESET  equ $03
ACIA_CTRL_INIT   equ $15

VEC_IRQ          equ $FFF8
VEC_SWI          equ $FFFA
VEC_NMI          equ $FFFC
VEC_RESET        equ $FFFE

MIKBUG_OUTCH     equ $E075
MIKBUG_INCH      equ $E078
MIKBUG_PDATA1    equ $E07E
MIKBUG_CONTRL    equ $E0E3
MIKBUG_INEEE     equ $E1AC
MIKBUG_OUTEEE    equ $E1D1
